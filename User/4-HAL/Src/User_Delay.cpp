/**
 * @file    User_Delay.cpp
 * @brief   用户延时实现
 *
 * @author  Tang-yucheng (QQ: 3143961287)
 * @date    2024-2-18
 * @version v1.0
 */

/* 头文件引用 ---------------------------------------------------------------------------------------------------------*/
#include "User_Delay.h"

/* 全局变量 -----------------------------------------------------------------------------------------------------------*/
static uint32_t SysClk = 0;     /* 系统时钟频率 */

/***********************************************************************************************************************
 * @brief   用户延时初始化函数
 * @note    由于在 HAL_Init() 中已对系统滴答定时器进行配置，所以此处无需重新配置
 * 
 * @param	sysclk: 系统时钟频率, 即CPU频率(rcc_c_ck)
 **********************************************************************************************************************/
void Delay_Init(uint16_t __SysClk)
{
	SysClk = __SysClk;
}

/***********************************************************************************************************************
 * @brief	延时nus
 * @note	nus取值范围: [0 - (2^32 / SysClk)]
 * 
 * @param	nus     延时时长 (us)
 **********************************************************************************************************************/
void Delay_us(uint32_t nus)
{
    uint32_t ticks = nus * SysClk;          /* 需要的节拍数 */
    uint32_t reload = SysTick->LOAD;        /* 系统滴答定时器重装载值 */
    uint32_t told, tnow, tcnt = 0;

    /* 记录刚进入时的计数器值 */
    told = SysTick->VAL;
    while (1)
    {
        tnow = SysTick->VAL;
        if (tnow != told)
        {
            /* 判断计数器是否被重装载 */
            if (tnow < told)
            {
                /* 注意：系统滴答定时器为递减定时器 */
                tcnt += told - tnow;
            }
            else
            {
                tcnt += reload - tnow + told;
            }
            told = tnow;

            /* 判断是否延时结束 */
            if (tcnt >= ticks) 
            {
                break;
            }
        }
    }
}

/***********************************************************************************************************************
 * @brief	延时nms
 * @note    nms取值范围: [0 - (2^32 / SysClk / 1000))]
 * 
 * @param	nms     延时时长 (ms)
 **********************************************************************************************************************/
void Delay_ms(uint16_t nms)
{
	Delay_us((uint32_t)(nms * 1000));
}

/***********************************************************************************************************************
 * @brief	HAL库延时函数重写
 * @note	HAL库的延时默认用Systick，如果我们没有开Systick的中断会导致调用这个延时后无法退出
 * 
 * @param 	Delay   延时时长 (ms)
 **********************************************************************************************************************/
void HAL_Delay(uint32_t Delay)
{
	Delay_ms(Delay);
}
